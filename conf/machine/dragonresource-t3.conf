## conf/machine/dragonresource-t3.conf
```bitbake
#
# Jailhouse, a Linux-based partitioning hypervisor
#
# Copyright (c) Siemens AG, 2018
#
# Authors:
#  Jan Kiszka <jan.kiszka@siemens.com>
#
# SPDX-License-Identifier: MIT
#

DISTRO_ARCH = "armhf"
# k.z adding sub arch type for sun8i
DISTRO_ARCH_SUB = "sun8i"
KERNEL_DEFCONFIG = "${DISTRO_ARCH}_sun8i_defconfig_5.10"

IMAGE_TYPE = "wic-img"
IMAGER_INSTALL += "u-boot-dragonresource-t3"
IMAGER_BUILD_DEPS += "u-boot-dragonresource-t3"

IMAGE_INSTALL += "u-boot-script"
```
